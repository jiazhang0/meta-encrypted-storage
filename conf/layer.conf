## conf/layer.conf
```bitbake
#
# Copyright (C) 2017 Wind River Systems, Inc.
#

# We have a conf and classes directory, add to BBPATH
BBPATH =. "${LAYERDIR}:"

# We have a packages directory, add to BBFILES
BBFILES += "${LAYERDIR}/recipes-*/*/*.bb \
        ${LAYERDIR}/recipes-*/*/*.bbappend"

BBFILE_COLLECTIONS += "meta-encrypted-storage"
BBFILE_PATTERN_meta-encrypted-storage = "^${LAYERDIR}/"
BBFILE_PRIORITY_meta-encrypted-storage = "7"

# This should only be incremented on significant changes that will
# cause compatibility issues with other layers
LAYERVERSION_meta-encrypted-storage = "1"

LAYERDEPENDS_meta-encrypted-storage = "\
    core \
    openembedded-layer \
    meta-tpm2 \
"
```
